## drivers/hmkpm/Kconfig
```kconfig
config HMKPM
	bool "HuntMemory page-table memory I/O (HMKPM)"
	depends on ARM64
	default n
	help
	  Built-in port of HuntMemory-KPM. Exposes single process
	  read/write through the getresuid magic-code channel.
```

## drivers/kernel_hack/Kconfig
```kconfig
config KERNEL_HACK
	tristate "Kernel Hack Driver (stealth read/write)"
	default m
	help
	  Driver kernel untuk membaca dan menulis memori proses secara langsung.
	  Mendukung penyembunyian diri dari /proc/modules, /proc/misc,
	  /proc/kallsyms, /sys/module/, dan lsmod.
	  Nama device node dibuat acak setiap kali driver dimuat.

config HW_BREAKPOINT_MODE
	bool "Hardware Breakpoint support in kernel_hack"
	depends on KERNEL_HACK && HW_BREAKPOINT
	default y
	help
	  Tambahkan dukungan hardware breakpoint ke driver kernel_hack.
	  Membutuhkan CONFIG_HW_BREAKPOINT=y di kernel.
```

## drivers/memdrv/Kconfig
```kconfig
# SPDX-License-Identifier: GPL-2.0-only
#
# Memory R/W driver (AArch64). Ported from Ghopp3r/Android-Memory-Kernel-Driver.

config MEMDRV
	tristate "Memory R/W kernel driver (memdrv)"
	depends on ARM64 && KPROBES && KALLSYMS && HAVE_HW_BREAKPOINT && UPROBES
	help
	  Process memory read/write, per-thread hardware breakpoints and
	  watchpoints, PTE inline hooks, touch injection, sensor uprobe and
	  fault harvest, exposed through a reboot()-magic handshake (no /dev
	  node). Loadable module: memdrv.ko.

	  If unsure, say N.

if MEMDRV

config MEMDRV_TARGET_PKG
	string "Target Android package"
	default "cent.tmgp.sgame"
	help
	  Package name the harvest subsystem locks onto.

config MEMDRV_REBOOT_MAGIC
	int "reboot() handshake magic"
	default 1193046
	help
	  Sentinel matched in the wrapped pt_regs of reboot(). Must equal
	  DRIVER_REBOOT_MAGIC1/2 in the userspace client. Default is 0x123456.

config MEMDRV_HIDE_SELF_MODULE
	bool "Hide module from /proc/modules and /sys/module"
	default y

config MEMDRV_HIDE_VMAP
	bool "Hide module vmap area from /proc/vmallocinfo"
	default y

config MEMDRV_HIDE_TASK
	bool "Hide PIDs and file names from directory listings"
	default y
	help
	  Arms a filldir64 kprobe that drops up to 8 /proc/<pid> entries and
	  16 exact-basename entries.

config MEMDRV_HIDE_KGSL_STRENGTH
	int "KGSL (Adreno GPU) concealment strength"
	range 0 3
	default 0
	help
	  0 = off, 1 = retroactive rb_erase, 2 = proactive kprobes,
	  3 = both. Levels 2 and 3 require MEMDRV_HIDE_TASK=y.
	  Per-SoC offsets: enable only after a runtime sanity check.

endif # MEMDRV
```

## drivers/misc/kernel_hack/Kconfig
```kconfig
config KERNEL_HACK
    tristate "Kernel Hack Driver (random-name RW)"
    default y
    help
      Loadable character device that provides cross-process physical
      memory read/write and module base resolution via ioctl.
      Device name is randomised at each load; module removes itself
      from /proc/modules while a client has the device open.
```

## drivers/misc/lkmc/Kconfig
```kconfig
# SPDX-License-Identifier: GPL-2.0-only
# lkmc: example kernel modules from cirosantilli/linux-kernel-module-cheat (GPL-3.0)
menu "lkmc example kernel modules"

config LKMC_RING0
	tristate "lkmc: ring0.c"
	default n
	help
	  Example module from kernel_modules/ring0.c of
	  cirosantilli/linux-kernel-module-cheat.

config LKMC_PMCCNTR
	tristate "lkmc: pmccntr.c"
	default n
	help
	  Example module from kernel_modules/pmccntr.c of
	  cirosantilli/linux-kernel-module-cheat.

config LKMC_VIRT_TO_PHYS
	tristate "lkmc: virt_to_phys.c"
	default n
	help
	  Example module from kernel_modules/virt_to_phys.c of
	  cirosantilli/linux-kernel-module-cheat.

config LKMC_HELLO
	tristate "lkmc: hello.c"
	default n
	help
	  Example module from kernel_modules/hello.c of
	  cirosantilli/linux-kernel-module-cheat.

config LKMC_PROCFS
	tristate "lkmc: procfs.c"
	default n
	help
	  Example module from kernel_modules/procfs.c of
	  cirosantilli/linux-kernel-module-cheat.

config LKMC_SYSFS
	tristate "lkmc: sysfs.c"
	default n
	help
	  Example module from kernel_modules/sysfs.c of
	  cirosantilli/linux-kernel-module-cheat.

config LKMC_DEBUGFS
	tristate "lkmc: debugfs.c"
	default n
	help
	  Example module from kernel_modules/debugfs.c of
	  cirosantilli/linux-kernel-module-cheat.

config LKMC_NETLINK
	tristate "lkmc: netlink.c"
	default n
	help
	  Example module from kernel_modules/netlink.c of
	  cirosantilli/linux-kernel-module-cheat.

config LKMC_IOCTL
	tristate "lkmc: ioctl.c"
	default n
	help
	  Example module from kernel_modules/ioctl.c of
	  cirosantilli/linux-kernel-module-cheat.

config LKMC_TIMER
	tristate "lkmc: timer.c"
	default n
	help
	  Example module from kernel_modules/timer.c of
	  cirosantilli/linux-kernel-module-cheat.

config LKMC_KTHREAD
	tristate "lkmc: kthread.c"
	default n
	help
	  Example module from kernel_modules/kthread.c of
	  cirosantilli/linux-kernel-module-cheat.

config LKMC_WORKQUEUE_CHEAT
	tristate "lkmc: workqueue_cheat.c"
	default n
	help
	  Example module from kernel_modules/workqueue_cheat.c of
	  cirosantilli/linux-kernel-module-cheat.

config LKMC_PARAMS
	tristate "lkmc: params.c"
	default n
	help
	  Example module from kernel_modules/params.c of
	  cirosantilli/linux-kernel-module-cheat.

config LKMC_CHARACTER_DEVICE
	tristate "lkmc: character_device.c"
	default n
	help
	  Example module from kernel_modules/character_device.c of
	  cirosantilli/linux-kernel-module-cheat.

config LKMC_VERMAGIC_FAIL
	tristate "lkmc: vermagic_fail.c"
	default n
	help
	  Example module from kernel_modules/vermagic_fail.c of
	  cirosantilli/linux-kernel-module-cheat.

config LKMC_WARN_ON
	tristate "lkmc: warn_on.c"
	default n
	help
	  Example module from kernel_modules/warn_on.c of
	  cirosantilli/linux-kernel-module-cheat.

config LKMC_MEMCPY_OVERFLOW
	tristate "lkmc: memcpy_overflow.c"
	default n
	help
	  Example module from kernel_modules/memcpy_overflow.c of
	  cirosantilli/linux-kernel-module-cheat.

config LKMC_STRLEN_OVERFLOW
	tristate "lkmc: strlen_overflow.c"
	default n
	help
	  Example module from kernel_modules/strlen_overflow.c of
	  cirosantilli/linux-kernel-module-cheat.

config LKMC_ANONYMOUS_INODE
	tristate "lkmc: anonymous_inode.c"
	default n
	help
	  Example module from kernel_modules/anonymous_inode.c of
	  cirosantilli/linux-kernel-module-cheat.

config LKMC_CHARACTER_DEVICE_CREATE
	tristate "lkmc: character_device_create.c"
	default n
	help
	  Example module from kernel_modules/character_device_create.c of
	  cirosantilli/linux-kernel-module-cheat.

config LKMC_DEP
	tristate "lkmc: dep.c"
	default n
	help
	  Example module from kernel_modules/dep.c of
	  cirosantilli/linux-kernel-module-cheat.

config LKMC_DEP2
	tristate "lkmc: dep2.c"
	default n
	help
	  Example module from kernel_modules/dep2.c of
	  cirosantilli/linux-kernel-module-cheat.

config LKMC_DUMP_REGS
	tristate "lkmc: dump_regs.c"
	default n
	help
	  Example module from kernel_modules/dump_regs.c of
	  cirosantilli/linux-kernel-module-cheat.

config LKMC_DUMP_STACK
	tristate "lkmc: dump_stack.c"
	default n
	help
	  Example module from kernel_modules/dump_stack.c of
	  cirosantilli/linux-kernel-module-cheat.

config LKMC_FOPS
	tristate "lkmc: fops.c"
	default n
	help
	  Example module from kernel_modules/fops.c of
	  cirosantilli/linux-kernel-module-cheat.

config LKMC_HELLO2
	tristate "lkmc: hello2.c"
	default n
	help
	  Example module from kernel_modules/hello2.c of
	  cirosantilli/linux-kernel-module-cheat.

config LKMC_INIT_MODULE
	tristate "lkmc: init_module.c"
	default n
	help
	  Example module from kernel_modules/init_module.c of
	  cirosantilli/linux-kernel-module-cheat.

config LKMC_KSTRTO
	tristate "lkmc: kstrto.c"
	default n
	help
	  Example module from kernel_modules/kstrto.c of
	  cirosantilli/linux-kernel-module-cheat.

config LKMC_MEMFILE
	tristate "lkmc: memfile.c"
	default n
	help
	  Example module from kernel_modules/memfile.c of
	  cirosantilli/linux-kernel-module-cheat.

config LKMC_MMAP
	tristate "lkmc: mmap.c"
	default n
	help
	  Example module from kernel_modules/mmap.c of
	  cirosantilli/linux-kernel-module-cheat.

config LKMC_MODULE_INFO
	tristate "lkmc: module_info.c"
	default n
	help
	  Example module from kernel_modules/module_info.c of
	  cirosantilli/linux-kernel-module-cheat.

config LKMC_MYPRINTK
	tristate "lkmc: myprintk.c"
	default n
	help
	  Example module from kernel_modules/myprintk.c of
	  cirosantilli/linux-kernel-module-cheat.

config LKMC_POLL
	tristate "lkmc: poll.c"
	default n
	help
	  Example module from kernel_modules/poll.c of
	  cirosantilli/linux-kernel-module-cheat.

config LKMC_SCHEDULE
	tristate "lkmc: schedule.c"
	default n
	help
	  Example module from kernel_modules/schedule.c of
	  cirosantilli/linux-kernel-module-cheat.

config LKMC_SCULL
	tristate "lkmc: scull.c"
	default n
	help
	  Example module from kernel_modules/scull.c of
	  cirosantilli/linux-kernel-module-cheat.

config LKMC_SEQ_FILE
	tristate "lkmc: seq_file.c"
	default n
	help
	  Example module from kernel_modules/seq_file.c of
	  cirosantilli/linux-kernel-module-cheat.

config LKMC_SEQ_FILE_SINGLE_OPEN
	tristate "lkmc: seq_file_single_open.c"
	default n
	help
	  Example module from kernel_modules/seq_file_single_open.c of
	  cirosantilli/linux-kernel-module-cheat.

config LKMC_VERMAGIC
	tristate "lkmc: vermagic.c"
	default n
	help
	  Example module from kernel_modules/vermagic.c of
	  cirosantilli/linux-kernel-module-cheat.

config LKMC_WORK_FROM_WORK
	tristate "lkmc: work_from_work.c"
	default n
	help
	  Example module from kernel_modules/work_from_work.c of
	  cirosantilli/linux-kernel-module-cheat.

config LKMC_SLEEP
	tristate "lkmc: sleep.c"
	default n
	help
	  Example module from kernel_modules/sleep.c of
	  cirosantilli/linux-kernel-module-cheat.

config LKMC_SYNC
	tristate "lkmc: sync.c"
	default n
	help
	  Example module from kernel_modules/sync.c of
	  cirosantilli/linux-kernel-module-cheat.

config LKMC_KTHREADS
	tristate "lkmc: kthreads.c"
	default n
	help
	  Example module from kernel_modules/kthreads.c of
	  cirosantilli/linux-kernel-module-cheat.

config LKMC_WAIT_QUEUE
	tristate "lkmc: wait_queue.c"
	default n
	help
	  Example module from kernel_modules/wait_queue.c of
	  cirosantilli/linux-kernel-module-cheat.

config LKMC_WAIT_QUEUE2
	tristate "lkmc: wait_queue2.c"
	default n
	help
	  Example module from kernel_modules/wait_queue2.c of
	  cirosantilli/linux-kernel-module-cheat.

config LKMC_KPROBE_EXAMPLE
	tristate "lkmc: kprobe_example.c"
	default n
	help
	  Example module from kernel_modules/kprobe_example.c of
	  cirosantilli/linux-kernel-module-cheat.

endmenu
```

## drivers/misc/my-driver/Kconfig
```kconfig
config MY_DRIVER
	tristate "Android memory kernel driver"
	depends on MODULES
	default m
	help
	  Out-of-tree memory R/W driver with hardware breakpoints,
	  PTE hooks, touch injection, and concealment layers.
```
